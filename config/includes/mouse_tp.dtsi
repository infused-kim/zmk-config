#ifdef HAS_MOUSE_TP
     #include <dt-bindings/zmk/mouse_settings.h>
#endif

// These are defines to make the keymap behavior for adjusting
// trackpoint settings shorter.
//
// For example, add U_MSS_TP_S_I to a keymap layer to create a key
// that increases the trackpoint sensitivity.
//
// Check the...
// `IBM TrackPoint System Version 4.0 Engineering Specification` (YKT3Eext.pdf)
// ... to learn more what these settings do.

#define U_MSS_TP_S_I &mms MS_TP_SENSITIVITY_INCR
#define U_MSS_TP_S_D &mms MS_TP_SENSITIVITY_DECR

#define U_MSS_TP_NI_I &mms MS_TP_NEG_INERTIA_INCR
#define U_MSS_TP_NI_D &mms MS_TP_NEG_INERTIA_DECR

#define U_MSS_TP_V6_I &mms MS_TP_VALUE6_INCR
#define U_MSS_TP_V6_D &mms MS_TP_VALUE6_DECR

#define U_MSS_TP_PT_I &mms MS_TP_PTS_THRESHOLD_INCR
#define U_MSS_TP_PT_D &mms MS_TP_PTS_THRESHOLD_DECR

#define U_MSS_RESET   &mms MS_RESET
#define U_MSS_LOG     &mms MS_LOG
