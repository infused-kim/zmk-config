// Make sure this file is included before all other files

/*
 * Layer Tap Settings
 */
&lt {
    // Increase layer tap time
    tapping-term-ms = <300>;

    // Quickly tap-tap-holding the lt button will repeat the tap behavior
    // For example enter-enter-hold, will output multiple enter while you
    // keep holding the key.
    // But holding enter without double tapping, will activate the layer.
     quick-tap-ms = <200>;

     flavor = "balanced";
};

/*
 * Caps Word Settings
 */
&caps_word {
    // Allow caps word to continue even when minus or underscore
    // are pressed.
    // Also prevent mod presses from cancelling caps word.
    continue-list = <
      UNDERSCORE MINUS
      LCTRL LALT LGUI LSHFT
      RCTRL RALT RGUI RSHFT
      BACKSPACE
    >;
    #ifdef HAS_UROB
        /delete-property/ ignore-modifiers;
    #endif
};

#ifdef HAS_CAPSLOCK
    &caps_word_capslock {
        disable-on-keys = <
            SPACE TAB ENTER ESCAPE
            COMMA DOT SEMI COLON QUESTION EXCLAMATION
            SLASH BACKSLASH SINGLE_QUOTE DOUBLE_QUOTES GRAVE
            LPAR RPAR LBKT RBKT LBRC RBRC LT GT
        >;
    };
#endif

#ifdef HAS_UROB
    &num_word {
        layers = <NUM_WORD>;
        continue-list = <
            BACKSPACE DELETE DOT COMMA
            SLASH ASTERISK PLUS MINUS EQUAL DOLLAR
            RS(SPACE)
        >;
        ignore-modifiers;  // modifiers don't deactivate the layer
    };
#endif
