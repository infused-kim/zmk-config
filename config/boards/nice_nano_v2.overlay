&pwm0 {
    status = "okay";
    ch0-pin = <6>;
    /* ch0-inverted; */
};

/ {
    backlight: pwmleds {
        compatible = "pwm-leds";
        label = "Backlight LEDs";
        pwm_led_0 {
            pwms = <&pwm0 6>;
            label = "Backlight LED 0";
        };
    };
};
