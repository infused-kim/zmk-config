## config/boards/shields/chocofi/Kconfig.shield
```kconfig
# Copyright (c) 2020 Pete Johanson
# SPDX-License-Identifier: MIT

config SHIELD_CHOCOFI_LEFT
	def_bool $(shields_list_contains,chocofi_left)

config SHIELD_CHOCOFI_RIGHT
	def_bool $(shields_list_contains,chocofi_right)
```

## config/boards/shields/sofle_choc/Kconfig.shield
```kconfig
# Copyright (c) 2020 Ryan Cross
# SPDX-License-Identifier: MIT

config SHIELD_SOFLE_CHOC_LEFT
	def_bool $(shields_list_contains,sofle_choc_left)

config SHIELD_SOFLE_CHOC_RIGHT
	def_bool $(shields_list_contains,sofle_choc_right)
```

## config/boards/shields/think_corney/Kconfig.defconfig
```kconfig
# The side with the PS2 Mouse / TP has to be the central half

if SHIELD_THINK_CORNEY_RIGHT

config ZMK_KEYBOARD_NAME
	default "ThinkCorney"

config ZMK_SPLIT_ROLE_CENTRAL
	default y

endif

if SHIELD_THINK_CORNEY_LEFT || SHIELD_THINK_CORNEY_RIGHT

config ZMK_SPLIT
	default y

endif
```

## config/boards/shields/think_corney/Kconfig.shield
```kconfig
# Copyright (c) 2020 Pete Johanson
# SPDX-License-Identifier: MIT

config SHIELD_THINK_CORNEY_LEFT
	def_bool $(shields_list_contains,think_corney_left)

config SHIELD_THINK_CORNEY_RIGHT
	def_bool $(shields_list_contains,think_corney_right)
```

## config/west.yml
```yaml
manifest:
  remotes:
    - name: zmkfirmware
      url-base: https://github.com/zmkfirmware
    - name: infused-kim
      url-base: https://github.com/infused-kim
    - name: petejohanson
      url-base: https://github.com/petejohanson
    - name: urob
      url-base: https://github.com/urob
    - name: badjeff
      url-base: https://github.com/badjeff/
    - name: dhruvinsh
      url-base: https://github.com/dhruvinsh

  projects:

    #
    # zmk fork
    # Uncomment only one of these...
    #

    # Standard, stable zmk repo without mouse PR.
    # Not compatible with the PS/2 mouse & TP driver module.
    # - name: zmk
    #   remote: zmkfirmware
    #   revision: main
    #   import: app/west.yml

    # infused-kim's zmk fork with mouse PR, which might be a bit outdated, but
    # is known to be compatible with the PS/2 mouse & TP driver module.
    - name: zmk
      remote: infused-kim
      revision: pr-testing/mouse_ps2_module_base
      import: app/west.yml

    # pete's zmk fork with the most up to date mouse PR, which is more
    # up-to-date, but may contain incompatibilities with the PS/2 mouse & TP
    # driver module.
    # - name: zmk
    #   remote: petejohanson
    #   revision: feat/pointers-move-scroll
    #   import: app/west.yml

    # urob's zmk fork with mouse PR & many extra features, but may be
    # incompatible with the PS/2 mouse & TP driver module.
    # - name: zmk
    #   remote: urob
    #   revision: main
    #   import: app/west.yml

    # infused-kim's zmk fork with mouse PR AND urob's improvements, which
    # might be out-dated, but is known to be compatible with PS/2 mouse & TP
    # driver module.
    # - name: zmk
    #   remote: infused-kim
    #   revision: pr-testing/mouse_ps2_module_base_urob
    #   import: app/west.yml

    #
    # Additional zmk modules
    #

    # Module for PS/2 mouse & TP driver
    - name: kb_zmk_ps2_mouse_trackpoint_driver
      remote: infused-kim
      revision: dev/2024-04-acceleration

    # zmk module for nice_peri_view
    - name: tmp-npv
      remote: infused-kim
      revision: main

    # Urob's zmk helpers that contain key position defines
    - name: zmk-helpers
      remote: urob
      revision: v2 # this will eventually become main

    # Tri-state behavior to make cmd+tab switching key
    # Used to be a key feature in urob's fork
    - name: zmk-tri-state
      remote: dhruvinsh
      revision: main

  self:
    path: config
```
